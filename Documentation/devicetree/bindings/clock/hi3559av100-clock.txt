## Documentation/devicetree/bindings/clock/hi3559av100-clock.txt
```
* Hisilicon Hi3559AV100 Clock Controller

The Hi3559AV100 clock controller generates and supplies clock to various
controllers within the HI3559AV100 SoC.

- compatible: the compatible should be one of the following strings to
  indicate the clock controller functionality. Should be one of the following.

  - "hisilicon,hi3559av100-clock"
  - "hisilicon,hi3559av100-shub-clock"

- reg: physical base address of the controller and length of memory mapped
  region.

- #clock-cells: Should be <1>.

Each clock is assigned an identifier and client nodes use this identifier
to specify the clock which they consume.

All these identifier could be found in <dt-bindings/clock/hi3559av100-clock.h>.

Examples:

	clock: clock0 {
		compatible = "hisilicon,hi3559av100-clock", "syscon";
		#clock-cells = <1>;
		reg = <0x0 0x12010000 0x0 0x10000>;
	};

	uart0: uart@12100000 {
		compatible = "arm,pl011", "arm,primecell";
		reg = <0x12100000 0x1000>;
		clocks = <&clock HI3559AV100_UART0_CLK>;
		clock-names = "apb_pclk";
	};
```

## block/blk-io-hierarchy/Kconfig
```kconfig
# SPDX-License-Identifier: GPL-2.0-only

menuconfig BLK_IO_HIERARCHY_STATS
	bool "Enable hierarchy io stats"
	default n
	depends on BLK_DEBUG_FS=y
	help
	Enabling this lets the block layer to record additional information
	in different io stages. Such information can be helpful to debug
	performance and problems like io hang.

	If unsure, say N.

if BLK_IO_HIERARCHY_STATS

config HIERARCHY_THROTTLE
	bool "Enable hierarchy stats layer blk-throttle"
	default n
	depends on BLK_DEV_THROTTLING=y
	help
	Enabling this lets blk hierarchy stats to record additional information
	for blk-throttle. Such information can be helpful to debug performance
	and problems like io hang.

	If unsure, say N.

endif
```
